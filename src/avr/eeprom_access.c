// Copyright (c) 2020 Hajo Kortmann <hajo.kortmann@gmx.de>
// License: GNU GPL v2 (see License.txt)

#include "eeprom_access.h"

EEMEM struct EEPROM_LAYOUT eeprom_layout = {
    .dummy = 0x00,
    
    // Address 0x01
    .secret = {
        0x00, 0x00, 0x00, 0x00, 0x00, 0x00, 0x00, 0x00, 
        0x00, 0x00, 0x00, 0x00, 0x00, 0x00, 0x00, 0x00,
        0x00, 0x00, 0x00, 0x00, 0x00, 0x00, 0x00, 0x00, 
        0x00, 0x00, 0x00, 0x00, 0x00, 0x00, 0x00, 0x00},
    
    // Address 0x21
    .sha256_k = {
    0x428a2f98, 0x71374491, 0xb5c0fbcf, 0xe9b5dba5, 0x3956c25b, 0x59f111f1,
    0x923f82a4, 0xab1c5ed5, 0xd807aa98, 0x12835b01, 0x243185be, 0x550c7dc3,
    0x72be5d74, 0x80deb1fe, 0x9bdc06a7, 0xc19bf174, 0xe49b69c1, 0xefbe4786,
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    0x90befffa, 0xa4506ceb, 0xbef9a3f7, 0xc67178f2},
    
    // Address 0x121
    .sha256_h0 = {
        0x6a09e667, 0xbb67ae85, 0x3c6ef372, 0xa54ff53a,
        0x510e527f, 0x9b05688c, 0x1f83d9ab, 0x5be0cd19},

    // Address 0x141, begin of unprotected space
    .kb_delay = 20,
     
    // Address 0x142
    // Keycodes, first byte modifier, second byte key
    .keycodes = {
        // a..r
        {0x00, 0x04}, {0x00, 0x05}, {0x00, 0x06},
        {0x00, 0x07}, {0x00, 0x08}, {0x00, 0x09},
        {0x00, 0x0a}, {0x00, 0x0b}, {0x00, 0x0c},
        {0x00, 0x0d}, {0x00, 0x0e}, {0x00, 0x0f},
        {0x00, 0x10}, {0x00, 0x11}, {0x00, 0x12},
        {0x00, 0x13}, {0x00, 0x14}, {0x00, 0x15},
        // A..R
        {0x02, 0x04}, {0x02, 0x05}, {0x02, 0x06},
        {0x02, 0x07}, {0x02, 0x08}, {0x02, 0x09},
        {0x02, 0x0a}, {0x02, 0x0b}, {0x02, 0x0c},
        {0x02, 0x0d}, {0x02, 0x0e}, {0x02, 0x0f},
        {0x02, 0x10}, {0x02, 0x11}, {0x02, 0x12},
        {0x02, 0x13}, {0x02, 0x14}, {0x02, 0x15},
        // 0..9
        {0x00, 0x27}, {0x00, 0x1e}, {0x00, 0x1f},
        {0x00, 0x20}, {0x00, 0x21}, {0x00, 0x22},
        {0x00, 0x23}, {0x00, 0x24}, {0x00, 0x25},
        {0x00, 0x26},
        // -, @, ! 
        {0x00, 0x2d}, {0x02, 0x1f}, {0x02, 0x1e},
        // ?, $, *
        {0x02, 0x38}, {0x02, 0x21}, {0x02, 0x25},
        // +, =, &
        {0x02, 0x2e}, {0x00, 0x2e}, {0x02, 0x24},
        // #, [, ]
        {0x02, 0x20}, {0x00, 0x2f}, {0x00, 0x30},
        // (, ), .
        {0x02, 0x26}, {0x02, 0x27}, {0x00, 0x37},
        // :, >, <
        {0x02, 0x33}, {0x02, 0x36}, {0x02, 0x37}
    }
};

int8_t ee_access_get_key_modifier(uint8_t index, uint8_t* modifier)
{
    if (index >= 64) {
        return 0;
    }
    *modifier = eeprom_read_byte(&(eeprom_layout.keycodes[index][0]));
    return 1;
}

int8_t ee_access_get_key_code(uint8_t index, uint8_t* keycode)
{
    if (index >= 64) {
        return 0;
    }
    *keycode = eeprom_read_byte(&(eeprom_layout.keycodes[index][1]));
    return 1;
}

int8_t ee_access_write_protected(uint16_t addr, uint8_t* data, uint8_t len)
{
    if ((addr >= 0x200) || ((addr + len) > 0x200)) {
        // Trying to write over the last eeprom address (512 bytes)
        // or to a non existing address
        return 0;
    }
    eeprom_update_block(data, ((uint8_t*)&eeprom_layout) + addr, len);
    return 1;
}

int8_t ee_access_write_unprotected(uint16_t addr, uint8_t* data, uint8_t len)
{
    if (((uint8_t*)(&eeprom_layout) + addr) < (uint8_t*)&(eeprom_layout.kb_delay)) {
        // Trying to write to protected space
        return 0;
    }
    return ee_access_write_protected(addr, data, len);
}

int8_t ee_access_read_keycodes(uint8_t buffer[86], uint8_t _begin, uint8_t _num)
{
    // We have to copy begin and len in order not to overwrite them
    uint8_t begin = _begin;
    uint8_t num = _num;
    // We store 64 keys
    if ((begin + num) > 64) {
        return 0;
    }
    // We don't want to overflow the buffer
    if (num > (86 / 2)) {
        return 0;
    }
    eeprom_read_block(buffer, &(eeprom_layout.keycodes[begin]), num * 2);
    return 1;
}

int8_t ee_access_read_kb_delay(uint8_t* buffer)
{
    buffer[0] = eeprom_read_byte(&eeprom_layout.kb_delay);
    return 1;
}
